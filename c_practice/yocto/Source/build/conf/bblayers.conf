## c_practice/yocto/Source/build/conf/bblayers.conf
```bitbake
# POKY_BBLAYERS_CONF_VERSION is increased each time build/conf/bblayers.conf
# changes incompatibly
POKY_BBLAYERS_CONF_VERSION = "2"

BBPATH = "${TOPDIR}"
BBFILES ?= ""

BBLAYERS ?= " \
  /c/Users/cpkumar/OneDrive-Capgemini/desktop/vs/practice/Learnings/c_practice/yocto/Source/poky/yocto_link/meta \
  /c/Users/cpkumar/OneDrive-Capgemini/desktop/vs/practice/Learnings/c_practice/yocto/Source/poky/yocto_link/meta-poky \
  /c/Users/cpkumar/OneDrive-Capgemini/desktop/vs/practice/Learnings/c_practice/yocto/Source/poky/yocto_link/meta-yocto-bsp \
  "
```
